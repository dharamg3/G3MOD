## Kernel/arch/arm/mach-s5p6442/Kconfig
```kconfig
# arch/arm/mach-s5p6442/Kconfig
#
# Copyright 2008 Openmoko, Inc.
# Copyright 2008 Simtec Electronics
# Copyright 2010 Samsung Electronics Co. Ltd.
#
# Licensed under GPLv2

# Configuration options for the S5P6442 CPU

config CPU_S5P6442
	bool
	select CPU_S5P6442_INIT
	select CPU_S5P6442_CLOCK
	help
	  Enable S5P6442 CPU support

config S5P6442_SETUP_SDHCI
	bool
	help
	  Internal helper functions for S5P6442 based SDHCI systems

menu "Samsung S5P6442 Implementations"

choice
        prompt "Select Machine"

config MACH_SMDK6442
	bool "SMDK6442"
	select CPU_S5P6442
	select S3C_DEV_HSMMC
	select S3C_DEV_HSMMC1
    select S3C_DEV_HSMMC2
	select S3C_DEV_I2C1
	select S5P6442_SETUP_SDHCI
	select S5P64XX_SETUP_I2C1
	select S3C_DMA_PL330
	help
	  Machine support for the Samsung SMDK6442

config MACH_APOLLO
        bool "APOLLO"
        select CPU_S5P6442
        select S3C_DEV_HSMMC
        select S3C_DEV_HSMMC1
        select S3C_DEV_HSMMC2
        select S3C_DEV_I2C1
        select S3C_DEV_I2C2
        select S5P6442_SETUP_SDHCI
        select S5P64XX_SETUP_I2C1
        select S5P64XX_SETUP_I2C2
	select S5P64XX_ADCTS
	select ARCH_DISCONTIGMEM_ENABLE
        select S3C_DMA_PL330
        help
          Machine support for the Samsung APOLLO BOARD

endchoice

config BOARD_REVISION
	hex "Select H/W Revision"
	depends on MACH_APOLLO
	default "0xFF"

config SEC_HEADSET
	tristate "SEC 2 Wire detection drvier"
	default n
	help
	 Provides support for detecting SEC 2 wire devices, such as wired headset.

config S5P_HIGH_RES_TIMERS_HZ
        int "HZ"
        default "256"
         help
            Kernel HRTimer HZ.

config LITE
	bool "Non-OC Kernel"
	depends on MACH_APOLLO
	help
		Provide non-overclocking CPU

config PERFORMANCE
	bool "OC Kernel"
	depends on MACH_APOLLO
	depends on LITE
	help
		Provide overclocking for the CPU

config ULTIMATE
	bool "OC+ Kernel"
	depends on MACH_APOLLO
	depends on PERFORMANCE
	help
		Provide more overclocking for the CPU	

config EXTREME
	bool "Extreme"
	depends on MACH_APOLLO
	depends on ULTIMATE
	help
		Provide extreme overclocking for the CPU	
endmenu
```

## Kernel/arch/arm/plat-s5p64xx/Kconfig
```kconfig
# arch/arm/plat-s5p64xx/Kconfig
#
# Copyright 2008 Openmoko, Inc.
# Copyright 2008 Simtec Electronics
#	Ben Dooks <ben@simtec.co.uk>
#
# Licensed under GPLv2

config PLAT_S5P64XX
	bool
	depends on ARCH_S5P64XX
	select PLAT_S3C
	select ARM_VIC
	default y
	select NO_IOPORT
	select ARCH_REQUIRE_GPIOLIB
	select S3C_GPIO_TRACK
	select S3C_GPIO_PULL_UPDOWN
	select S3C_GPIO_CFG_S5P64XX
	help
	  Base platform code for any Samsung S5P64XX device

if PLAT_S5P64XX

# Configuration options shared by all S5P64XX implementations

config CPU_S5P6442_INIT
	bool
	help
	  Initialisation code for the S5P6440. 

config CPU_S5P6442_CLOCK
	bool
	help
	  Clock support code for the S5P6440.

# platform specific device setup

config S5P64XX_SETUP_I2C0
	bool
	default y
	help
	  Common setup code for i2c bus 0.

	  Note, currently since i2c0 is always compiled, this setup helper
	  is always compiled with it.

config S5P64XX_SETUP_I2C1
	bool
	help
	  Common setup code for i2c bus 1.

config S5P64XX_SETUP_I2C2
	bool
	help
	  Common setup code for i2c bus 2.

# tony

config S3C_DEV_HSMMC
        bool
        help
          Compile in platform device definitions for HSMMC channel 0

config S3C_DEV_HSMMC1
        bool
        help
          Compile in platform device definitions for HSMMC channel 1

config S3C_DEV_HSMMC2
        bool
        help
          Compile in platform device definitions for HSMMC channel 2

config S3C_DEV_I2C1
        bool
        help
          Compile in platform device definitions for I2C channel 1

config S3C_DEV_I2C2
        bool
        help
          Compile in platform device definitions for I2C channel 2


config S5P64XX_ADCTS
	bool
	default y
	help
	  Common setup code for adc and touchscreen

# FIMC part
config S5P64XX_DEV_FIMC0
	bool
	default y
	help
	  Compile in platform device definitions for FIMC controller 0

config S5P64XX_DEV_FIMC1
	bool
	default y
	help
	  Compile in platform device definitions for FIMC controller 1

config S5P64XX_DEV_FIMC2
	bool
	default y
	help
	  Compile in platform device definitions for FIMC controller 2

config S5P64XX_SETUP_FIMC0
	bool
	default y
	help
	  Common setup code for FIMC controller 0.

config S5P64XX_SETUP_FIMC1
	bool
	default y
	help
	  Common setup code for FIMC controller 1.

config S5P64XX_SETUP_FIMC2
	bool
	default y
	help
	  Common setup code for FIMC controller 2.
	  
# FB part
config S5P64XX_DEV_FB
	bool
	depends on FB_S3C
	default y
	help
	  Compile in platform device definitions for FIMD controller

choice
        prompt "PWM device support"
        default NO_PWM

config S5P64XX_PWM
        bool "Support Old API"
        help
          Support for exporting the PWM timer blocks via old type API

config TIMER_PWM
        bool "PWM device support"
        help
           Support for exporting the PWM timer blocks via the pwm device

config NO_PWM
        bool "No PWM support"
        help
           PWM is not supported

endchoice

choice
		prompt "Touchscreen type"
		default R_TYPE

config S5P64XX_TS_R_TYPE
		bool "Use R-Type Touchscreen"
		select TOUCHSCREEN_S3C
		help 
		  Support R-Type Touchscreen only
	
config S5P64XX_TS_C_TYPE
		bool "Use C-Type Touchscreen"
#		select TOUCHSCREEN_QT602240
		help
		  Support C-Type Touchscreen only

endchoice

#config S5P64XX_PWM
#	bool "S5P64XX PWM support"
#	select S5P_HAVE_PWM
#	help
#	  Support for exporting the PWM timer blocks via the pwm device system.

config S5P64XX_POWER_GATING
	bool "Support S5P64XX Power Gating"
	depends on PM
	default n
	help
	  block power enable / disble when each block is active / idle

config S5P64XX_POWER_GATING_DEBUG
	bool "Support S5P64XX Power Gating Debug"
	depends on S5P64XX_POWER_GATING
	default n
	help
	  s5p64xx power gating debug message enable / disable

config S5P64XX_CLOCK_GATING
	bool "Support S5P64XX Clock Gating"
	depends on PM
	default n
	help
	  clock enable / disble when each IP is active / idle

config S5P64XX_CLOCK_GATING_DEBUG
	bool "Support S5P64XX Clock Gating Debug"
	depends on S5P64XX_CLOCK_GATING
	default n
	help
	  s5p64xx clock gating debug message enable / disable

config S5P64XX_LPAUDIO
	bool "Support S5P64XX Low Power(LP) Audio"
	depends on CPU_IDLE
	default n
	help
	  s5p64xx low power audio enable / disable

config ANDROID_BUF_NUM
	depends on S5P64XX_LPAUDIO
	int
	default 4

config S5P64XX_HIGH_RES_TIMERS
	bool "HRtimer and Dynamic Tick support"
	select GENERIC_TIME
	select GENERIC_CLOCKEVENTS
	select HIGH_RES_TIMERS
	default n
	help
	  Support for HRtimer and Dynamic Tick System

choice
	prompt "Select HRT source timer"
	depends on S5P64XX_HIGH_RES_TIMERS
	default HRT_PWM

config HRT_PWM
	bool "PWM timers(2/4)"
	help
	  PWM timers are used as HRT
config HRT_RTC
	bool "RTC/SYSTEM TIMER"
	help
	  RTC and System timer are used as HRT
endchoice
endif
```

## Kernel/drivers/media/s5p6442/fimc_drv/Kconfig
```kconfig
config VIDEO_FIMC
	bool "Samsung Camera Interface (FIMC) driver"
	depends on VIDEO_DEV && (CPU_S5PC100 || CPU_S5PC110 || CPU_S5P6442)
	select VIDEO_IPC if CPU_S5PC110
	default n
	---help---
	  This is a video4linux driver for Samsung FIMC device.

config VIDEO_IPC
	bool

config VIDEO_FIMC_DEBUG
	bool "FIMC driver debug messages"
	depends on VIDEO_FIMC

config VIDEO_FIMC_MIPI
	bool "MIPI-CSI2 Slave Interface support"
	depends on VIDEO_FIMC && (CPU_S5PC100 || CPU_S5PC110)
	
source "drivers/media/s5p6442/fimc_drv/Kconfig-camera"

config VIDEO_SAMSUNG_V4L2
	bool "V4L2 API for digital camera to be contributed by samsung"
	depends on VIDEO_DEV && VIDEO_FIMC
	default n
	---help---
	 This feature is for new V4L2 APIs all about digital camera

comment "FIMC Reserved memory configurations"

config VIDEO_SAMSUNG_MEMSIZE_FIMC0
	int "Memory size in kbytes for FIMC0"
	depends on VIDEO_FIMC
	default "5120"

config VIDEO_SAMSUNG_MEMSIZE_FIMC1
	int "Memory size in kbytes for FIMC1"
	depends on VIDEO_FIMC
	default "5120"

config VIDEO_SAMSUNG_MEMSIZE_FIMC2
	int "Memory size in kbytes for FIMC2"
	depends on VIDEO_FIMC
	default "5120"
```

## Kernel/drivers/media/s5p6442/g2d_drv/Kconfig
```kconfig
#
# G2D subsystem configuration
#

#menu "G2D Support"

config VIDEO_G2D
	tristate "Samsung FIMG-2D Driver"
#	bool "Samsung FIMG-3DSE Driver"
	depends on CPU_S5P6442
	default n
	help
		FIMG-2D

#endmenu
```

## Kernel/drivers/media/s5p6442/g3d_drv_samsung/Kconfig
```kconfig
#
# G3D subsystem configuration
#

#menu "G3D Support"

config VIDEO_G3D
	tristate "Samsung FIMG-3DSE Driver"
#	bool "Samsung FIMG-3DSE Driver"
	depends on CPU_S5P6442
	default n
	help
		FIMG-3D

#endmenu
```

## Kernel/drivers/media/s5p6442/jpeg_v2/Kconfig
```kconfig
#
# Configuration for JPEG
#

config VIDEO_JPEG_V2
	bool "Samsung JPEG driver"
	depends on CPU_S5P6442
	default n
	---help---
	  This is a JPEG for Samsung S5PC100 & S5PC110 & S5P6442

comment "JPEG Reserved memory configurations"

config VIDEO_SAMSUNG_MEMSIZE_JPEG
	int "Memory size in kbytes for JPEG"
	depends on VIDEO_JPEG_V2 
	default "5120"

config VIDEO_JPEG_DEBUG
	bool "print JPEG debug message"
	depends on VIDEO_JPEG_V2
	default n
```

## Kernel/drivers/media/s5p6442/mfc/Kconfig
```kconfig
#
# Makefile for MFC device driver designed by Samsung Electronics 2010
#
config S5P6442_MFC
        bool "Samsung MFC (Multi Format Codec - FIMV 1.0) Driver"
        depends on CPU_S5P6442
        default y
        ---help---
          This is a Samsung Multi Format Codecs (MFC) FIMV V1.0 - driver for Samsung S5P6442/S3C64XX
```

## Kernel/drivers/sensor/Kconfig
```kconfig
#
#
#


menuconfig NEW_SENSORS
	bool "Sensors Support"
	help
	  Say Y to enable Sensors support.  This allows control of supported
	  Sensors.

	  
	  

if NEW_SENSORS

source "drivers/sensor/accel/Kconfig"

source "drivers/sensor/compass/Kconfig"

source "drivers/sensor/proximity/Kconfig"



endif # NEW_SENSORS
```

## Kernel/drivers/sensor/proximity/Kconfig
```kconfig
#
# MAGNETIC Sensor Configuration
#



config PROXIMITY                                                              
	bool "PROXIMITY Sensor"
	default y
	help
	This option enables proximity sensors  
	   

config PROXIMITY_CM3607
	depends on PROXIMITY
	tristate "Proximity sensor driver for s5p6442"
	default n
	help
	  This option enables proximity sensor using cm3607.
	  

config PROXIMITY_GP2A
	depends on PROXIMITY
	tristate "Proximity sensor driver for s5p6442"
	default y
	help
	  This option enables proximity sensor using GP2AP002S00F.
```

## Kernel/modules/vibetonz/Kconfig
```kconfig
config CONFIG_VIBETONZ
	default m
	tristate "Broadcom WiFi Driver"
	---help---
		Select this option to build Broadcom wlan driver
```

## Kernel/sound/soc/s5p/Kconfig
```kconfig
config SND_S5P_SOC
	tristate "Samsung SoC Audio"
	depends on ARCH_S5PC1XX || ARCH_S5PC11X || ARCH_S5P64XX
	help
	  Say Y or M if you want to add support for codecs attached to
	  the S3C AC97, I2S or SSP interface. You will also need
	  to select the audio interfaces to support below.

config SND_S3C_I2S_V50
	tristate

config SND_S3C_AC97
	tristate

choice
	prompt "Select the codec driver"
	depends on SND_S5P_SOC

config  SND_SMDKC110_WM8580
	tristate "WM8580-I2S on SMDKC110"
	depends on ARCH_S5PC11X
	select SND_S3C_I2S_V50
	select SND_SOC_WM8580

config	SND_APOLLO_WM8994
	tristate "I2S Audio Interface with WM8994 on APOLLO"
	depends on ARCH_S5P64XX
	select SND_S3C_I2S_V50
	select SND_SOC_WM8994
	help
		The audio codec chip of Apollo board is WM8994.
		I2S_V50(I2S version 5.1 : IIS Multi Audio Interface) is used for Apollo.

config SND_S5P64XX_SOC_I2S_REC_DOWNSAMPLING
    bool "SoC I2S Audio Support : downsampling for Android platform Audio Recording"
	depends on SND_APOLLO_WM8994
	default y
	help
		Say Y if you want to add support for Rec Downsampling with the WM8994.
		to use I2S channel in/out stream at the same time. (should be use the same sampling rate)

config	SND_WM8994_MASTER_MODE
    bool "SoC I2S Audio Support : WM8994-master mode (I2s-slave)"
	depends on SND_APOLLO_WM8994
	default y
	help
		=> #idef CONFIG_SND_WM8994_MASTER
		WM8994 generates LRCLK & SCLK to drive I2S.

config ANDROID_BUF_NUM
         int "Default number of Audio Ring Buffer"
         default "16"
         depends on !S5P64XX_LPAUDIO && SND_APOLLO_WM8994
         help
                 Number of Audio Ring Buffer for Android Platform.


config  SND_SMDKC100_WM8580
	tristate "WM8580-I2S on SMDKC100"
	depends on ARCH_S5PC1XX
	select SND_S3C_I2S_V50
	select SND_SOC_WM8580

config  SND_SMDKC100_S5M8751
	tristate "S5M8751-I2S on SMDKC100"
	depends on ARCH_S5PC1XX
	select SND_S3C_I2S_V32
	select SND_SOC_S5M8751

config  SND_SMDKC100_WM9713
	tristate "WM9713-AC97 on SMDKC100"
	depends on ARCH_S5PC1XX
	select SND_S3C_AC97
	select SND_SOC_WM9713

config SND_S5PC100_SOC_UNIVERSAL_AK4671
	tristate "SoC I2S Audio support for UNIVERSAL - AK4671"
	depends on ARCH_S5PC1XX
	select SND_S3C_I2S_V50
	select SND_SOC_AK4671
	select SND_SOC_MAX9877
	help
	  Say Y if you want to add support for SoC audio on universal
	  with the AK4671.

config  SND_SMDK6442_WM8580
	tristate "WM8580-I2S on SMDK6442"
	depends on ARCH_S5P64XX
	select SND_S3C_I2S_V50
	select SND_SOC_WM8580

endchoice

config  SND_WM8580_MASTER
	bool "WM8580 Codec is I2S Master"
	depends on SND_SMDKC110_WM8580 || SND_SMDKC100_WM8580 || SND_SMDK6442_WM8580
	default n
```
